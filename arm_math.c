
/*
 * Feiyu gimbal hack
 *
 * Copyright (C) 2016 Adam Williams <broadcast at earthling dot net>
 * 
 * This program is free software; you can redistribute it and/or modify
 * it under the terms of the GNU General Public License as published by
 * the Free Software Foundation; either version 2 of the License, or
 * (at your option) any later version.
 * 
 * This program is distributed in the hope that it will be useful,
 * but WITHOUT ANY WARRANTY; without even the implied warranty of
 * MERCHANTABILITY or FITNESS FOR A PARTICULAR PURPOSE.  See the
 * GNU General Public License for more details.
 * 
 * You should have received a copy of the GNU General Public License
 * along with this program; if not, write to the Free Software
 * Foundation, Inc., 59 Temple Place, Suite 330, Boston, MA  02111-1307  USA
 * 
 */

 
//#include "settings.h"
#include "feiyu_uart.h"
#include "arm_linux.h"
#include "arm_math.h"
//#include "copter.h"
//#include "mpu9150.h"


// created by mathtables.c


const int16_t atan_table[] = {
// x=0-128 y=128
	0x0000, 0x0072, 0x00e5, 0x0157, 0x01ca, 0x023c, 0x02af, 0x0321, 
	0x0393, 0x0405, 0x0477, 0x04e9, 0x055b, 0x05cc, 0x063d, 0x06af, 
	0x0720, 0x0790, 0x0801, 0x0871, 0x08e1, 0x0951, 0x09c0, 0x0a2f, 
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	0x2d00, 
// x=128 y=0-128
	0x5a00, 0x598d, 0x591a, 0x58a8, 0x5835, 0x57c3, 0x5750, 0x56de, 
	0x566c, 0x55fa, 0x5588, 0x5516, 0x54a4, 0x5433, 0x53c2, 0x5350, 
	0x52df, 0x526f, 0x51fe, 0x518e, 0x511e, 0x50ae, 0x503f, 0x4fd0, 
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	0x2ed8, 0x2e9c, 0x2e5f, 0x2e24, 0x2de8, 0x2dad, 0x2d73, 0x2d39, 
	0x2d00
	};
// static const int16_t sin_table[] = {
// 	0x0000, 0x0001, 0x0003, 0x0004, 0x0006, 0x0007, 0x0009, 0x000b, 
// 	0x000c, 0x000e, 0x000f, 0x0011, 0x0012, 0x0014, 0x0016, 0x0017, 
// 	0x0019, 0x001a, 0x001c, 0x001d, 0x001f, 0x0021, 0x0022, 0x0024, 
// 	0x0025, 0x0027, 0x0028, 0x002a, 0x002b, 0x002d, 0x002f, 0x0030, 
// 	0x0032, 0x0033, 0x0035, 0x0036, 0x0038, 0x0039, 0x003b, 0x003c, 
// 	0x003e, 0x003f, 0x0041, 0x0043, 0x0044, 0x0046, 0x0047, 0x0049, 
// 	0x004a, 0x004c, 0x004d, 0x004f, 0x0050, 0x0052, 0x0053, 0x0055, 
// 	0x0056, 0x0058, 0x0059, 0x005b, 0x005c, 0x005d, 0x005f, 0x0060, 
// 	0x0062, 0x0063, 0x0065, 0x0066, 0x0068, 0x0069, 0x006a, 0x006c, 
// 	0x006d, 0x006f, 0x0070, 0x0072, 0x0073, 0x0074, 0x0076, 0x0077, 
// 	0x0079, 0x007a, 0x007b, 0x007d, 0x007e, 0x0080, 0x0081, 0x0082, 
// 	0x0084, 0x0085, 0x0086, 0x0088, 0x0089, 0x008a, 0x008c, 0x008d, 
// 	0x008e, 0x0090, 0x0091, 0x0092, 0x0093, 0x0095, 0x0096, 0x0097, 
// 	0x0099, 0x009a, 0x009b, 0x009c, 0x009e, 0x009f, 0x00a0, 0x00a1, 
// 	0x00a2, 0x00a4, 0x00a5, 0x00a6, 0x00a7, 0x00a8, 0x00aa, 0x00ab, 
// 	0x00ac, 0x00ad, 0x00ae, 0x00af, 0x00b1, 0x00b2, 0x00b3, 0x00b4, 
// 	0x00b5, 0x00b6, 0x00b7, 0x00b8, 0x00b9, 0x00bb, 0x00bc, 0x00bd, 
// 	0x00be, 0x00bf, 0x00c0, 0x00c1, 0x00c2, 0x00c3, 0x00c4, 0x00c5, 
// 	0x00c6, 0x00c7, 0x00c8, 0x00c9, 0x00ca, 0x00cb, 0x00cc, 0x00cd, 
// 	0x00ce, 0x00cf, 0x00d0, 0x00d0, 0x00d1, 0x00d2, 0x00d3, 0x00d4, 
// 	0x00d5, 0x00d6, 0x00d7, 0x00d7, 0x00d8, 0x00d9, 0x00da, 0x00db, 
// 	0x00dc, 0x00dc, 0x00dd, 0x00de, 0x00df, 0x00e0, 0x00e0, 0x00e1, 
// 	0x00e2, 0x00e3, 0x00e3, 0x00e4, 0x00e5, 0x00e5, 0x00e6, 0x00e7, 
// 	0x00e7, 0x00e8, 0x00e9, 0x00e9, 0x00ea, 0x00eb, 0x00eb, 0x00ec, 
// 	0x00ec, 0x00ed, 0x00ee, 0x00ee, 0x00ef, 0x00ef, 0x00f0, 0x00f0, 
// 	0x00f1, 0x00f1, 0x00f2, 0x00f2, 0x00f3, 0x00f3, 0x00f4, 0x00f4, 
// 	0x00f5, 0x00f5, 0x00f6, 0x00f6, 0x00f7, 0x00f7, 0x00f7, 0x00f8, 
// 	0x00f8, 0x00f9, 0x00f9, 0x00f9, 0x00fa, 0x00fa, 0x00fa, 0x00fb, 
// 	0x00fb, 0x00fb, 0x00fb, 0x00fc, 0x00fc, 0x00fc, 0x00fc, 0x00fd, 
// 	0x00fd, 0x00fd, 0x00fd, 0x00fe, 0x00fe, 0x00fe, 0x00fe, 0x00fe, 
// 	0x00fe, 0x00ff, 0x00ff, 0x00ff, 0x00ff, 0x00ff, 0x00ff, 0x00ff, 
// 	0x00ff, 0x00ff, 0x00ff, 0x00ff, 0x00ff, 0x00ff, 0x00ff, 0x0100,
// 	0x0100 };

// greater precision is required for the motor table
const int16_t sin_table[] = {
        0x0000, 0x0064, 0x00c9, 0x012d, 0x0192, 0x01f6, 0x025b, 0x02bf, 
        0x0323, 0x0388, 0x03ec, 0x0451, 0x04b5, 0x0519, 0x057d, 0x05e1, 
        0x0645, 0x06a9, 0x070d, 0x0771, 0x07d5, 0x0839, 0x089c, 0x0900, 
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        0x3fec, 0x3ff0, 0x3ff4, 0x3ff8, 0x3ffb, 0x3ffd, 0x3ffe, 0x3fff,
		0x4000
};


const int16_t tan_table[] = {
	0x0000, 0x0001, 0x0003, 0x0004, 0x0006, 0x0007, 0x0009, 0x000b, 
	0x000c, 0x000e, 0x000f, 0x0011, 0x0012, 0x0014, 0x0016, 0x0017, 
	0x0019, 0x001a, 0x001c, 0x001e, 0x001f, 0x0021, 0x0022, 0x0024, 
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	0x172d, 0x1b0b, 0x2075, 0x2893, 0x361b, 0x512a, 0x7f00, 0x7f00,
	0x7fff };






int mul_fixed(int x, int y)
{
	return x * y / FRACTION;
}

int tan_fixed(int angle)
{
	while(angle < 0) angle += 360 * FRACTION;
	while(angle >= 360 * FRACTION) angle -= 360 * FRACTION;

// 0 - 90
	if(angle <= 90 * FRACTION)
	{
		int index = angle / 90;
		return tan_table[index];
	}
	else
// 90 - 180
	if(angle <= 180 * FRACTION)
	{
		int index = FRACTION - (angle - 90 * FRACTION) / 90;
		return -tan_table[index];
	}
	else
// 180 - 270
	if(angle <= 270 * FRACTION)
	{
		int index = (angle - 180 * FRACTION) / 90;
		return tan_table[index];
	}
	else
// 270 - 360
	{
		int index = FRACTION - (angle - 270 * FRACTION) / 90;
		return -tan_table[index];
	}
}

int atan2_fixed(int y, int x)
{
	int x_abs = abs_fixed(x);
	int y_abs = abs_fixed(y);
	int angle = 0;

// normalize
	if(x_abs == 0 && y_abs == 0)
	{
		return 0;
	}
	else
	if(x_abs >= y_abs)
	{
		int y_normalized = y_abs * 128 / x_abs;
		CLAMP(y_normalized, 0, 128);
		angle = atan_table[y_normalized];
	}
	else
	{
		int x_normalized = x_abs * 128 / y_abs;
		CLAMP(x_normalized, 0, 128);
		angle = atan_table[129 + x_normalized];
	}

	if(y >= 0 && x >= 0) 
		return angle;
	else
	if(y <= 0 && x >= 0)
		return -angle;
	else
	if(y >= 0 && x <= 0)
		return 180 * FRACTION - angle;
	else
		return -180 * FRACTION + angle;

}


// get the table sign & index
void sin_index(int *sign, int *index, int angle)
{
	while(angle < 0) angle += 360 * FRACTION;
	while(angle >= 360 * FRACTION) angle -= 360 * FRACTION;

// 270 - 360
	if(angle >= 270 * FRACTION)
	{
		*index = (360 * FRACTION - angle) / 90;
		*sign = -1;
	}
	else
// 180 - 270
	if(angle >= 180 * FRACTION)
	{
		*index = (angle - 180 * FRACTION) / 90;
		*sign = -1;
	}
	else
// 90 - 180
	if(angle >= 90 * FRACTION)
	{
		*index = (180 * FRACTION - angle) / 90;
		*sign = 1;
	}
	else
// 0 - 90
	{
		*index = angle / 90;
		*sign = 1;
	}
}

int sin_fixed(int angle)
{
	int sign, index;
	sin_index(&sign, &index, angle);
	return sign * sin_table[index] >> 6;
}

int sin_fixed14(int angle)
{
	int sign, index;
	sin_index(&sign, &index, angle);
	return sign * sin_table[index];
}





int cos_fixed(int angle)
{
	return sin_fixed(angle + 90 * FRACTION);
}


#if 0
void euler_dc(matrix_t *dst, vector_t *euler)
{
	int	cpsi;
	int	cphi;
	int	ctheta;

	int	spsi;
	int	sphi;
	int	stheta;

	if(euler->x == 0 && euler->y == 0)
	{
		cpsi	= 1 * FRACTION;
		cphi	= 1 * FRACTION;
		ctheta	= 1 * FRACTION;

		spsi	= 0 * FRACTION;
		sphi	= 0 * FRACTION;
		stheta	= 0 * FRACTION;
	}
	else
	{
		int phi = -euler->y;
		int theta	= euler->x;
		int psi = euler->z;

		cpsi	= cos_fixed(psi);
		cphi	= cos_fixed(phi);
		ctheta	= cos_fixed(theta);

		spsi	= sin_fixed(psi);
		sphi	= sin_fixed(phi);
		stheta	= sin_fixed(theta);
	}


	MATRIX_ENTRY(*dst, 0, 0) = mul_fixed(cpsi, ctheta);
	MATRIX_ENTRY(*dst, 0, 1) = mul_fixed(spsi, ctheta);
	MATRIX_ENTRY(*dst, 0, 2) = -stheta;

	MATRIX_ENTRY(*dst, 1, 0) = mul_fixed(-spsi, cphi) + mul_fixed(mul_fixed(cpsi, stheta), sphi);
	MATRIX_ENTRY(*dst, 1, 1) = mul_fixed(cpsi, cphi) + mul_fixed(mul_fixed(spsi, stheta), sphi);
	MATRIX_ENTRY(*dst, 1, 2) = mul_fixed(ctheta, sphi);

	MATRIX_ENTRY(*dst, 2, 0) = mul_fixed(spsi, sphi) + mul_fixed(mul_fixed(cpsi, stheta), cphi);
	MATRIX_ENTRY(*dst, 2, 1) = mul_fixed(-cpsi, sphi) + mul_fixed(mul_fixed(spsi, stheta), cphi);
	MATRIX_ENTRY(*dst, 2, 2) = mul_fixed(ctheta, cphi);
}

void transpose_matrix(matrix_t *dst, 
	matrix_t *src)
{
	int i, j;


	for(i = 0; i < src->rows; i++)
	{
		int *src_row = MATRIX_ROW(*src, i);
		for(j = 0; j < src->columns; j++)
			MATRIX_ENTRY(*dst, j, i) = src_row[j];
	}
}



void distance_angle(int *distance, 
	int *angle, 
	int x1,
	int y1,
	int x2, 
	int y2)
{
	*distance = 0;
	*angle = 0;

	if(x1 == x2 && y1 == y2)
	{
		return;
	}

	*angle = atan2_fixed(y2 - y1, x2 - x1);
	if(abs_fixed(x2 - x1) > abs_fixed(y2 - y1))
	{
		*distance = (x2 - x1) * FRACTION / cos_fixed(*angle);
	}
	else
	{
		*distance = (y2 - y1) * FRACTION / sin_fixed(*angle);
	}
	
}
#endif // 0




void multiply_matrix_vector(vector_t *dst, matrix_t *mat, vector_t *vec)
{
	int i, j;
	int n = mat->rows;
	int m = mat->columns;


	for(i = 0; i < n; i++)
	{
		int s = 0;
		for(j = 0; j < m; j++)
			s += mul_fixed(MATRIX_ENTRY(*mat, i, j), VECTOR_ENTRY(*vec, j));
		VECTOR_ENTRY(*dst, i) = s;
	}
}

void print_matrix(matrix_t *mat)
{
	int i, j;
	print_lf(&uart);
	for(i = 0; i < mat->rows; i++)
	{
		for(j = 0; j < mat->rows; j++)
		{
			print_fixed(&uart, MATRIX_ENTRY(*mat, i, j));
		}
		print_lf(&uart);
	}
}

void print_vector(vector_t *vec)
{
	int i, j;
	for(i = 0; i < vec->size; i++)
	{
		print_fixed(&uart, VECTOR_ENTRY(*vec, i));
	}
	print_lf(&uart);
}






int get_angle_change(int old_angle, int new_angle)
{
	int result = new_angle - old_angle;
	if(result > 180) result -= 360;
	else
	if(result < -180) result += 360;
	return result;
}


int get_angle_change_fixed(int old_angle, int new_angle)
{
	int result = new_angle - old_angle;
	if(result > 180 * FRACTION) result -= 360 * FRACTION;
	else
	if(result < -180 * FRACTION) result += 360 * FRACTION;
	return result;
}

int fix_angle(int angle)
{
	if(angle > 180 * FRACTION) angle -= 360 * FRACTION;
	if(angle < -180 * FRACTION) angle += 360 * FRACTION;
	return angle;
}



// Zero derivative structure
void init_derivative(derivative_t *ptr, int buffer_size)
{
	bzero(ptr->prev, buffer_size * sizeof(int));
	ptr->total = buffer_size;
	ptr->index = 0;
}

void reset_derivative(derivative_t *ptr)
{
//printf("reset_derivative %d: allocated=%d\n", __LINE__, ptr->allocated);
	bzero(ptr->prev, ptr->total * sizeof(int));
	ptr->index = 0;
}


// Push new value on derivative buffer
void update_derivative(derivative_t *ptr, int value)
{
	ptr->prev[ptr->index] = value;
	ptr->index++;
	if(ptr->index >= ptr->total) ptr->index = 0;
	
}


// Get derivative
int get_derivative(derivative_t *ptr)
{
	int current_index = ptr->index - 1;
	if(current_index < 0) current_index = ptr->total - 1;
	return ptr->prev[current_index] - ptr->prev[ptr->index];
}

// get sum of all values
int get_sum(derivative_t *ptr)
{
	int i;
	int sum = 0;

	for(i = 0; i < ptr->total; i++)
	{
		sum += ptr->prev[i];
	}
	
	return sum;
}



